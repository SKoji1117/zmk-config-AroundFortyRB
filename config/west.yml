## config/west.yml
```yaml
manifest:
  remotes:
    - name: zmkfirmware
      url-base: https://github.com/zmkfirmware
    - name: inorichi
      url-base: https://github.com/inorichi
    - name: caksoylar
      url-base: https://github.com/caksoylar
  projects:
    - name: zmk
      remote: zmkfirmware
      revision: v0.2-branch
      import: app/west.yml
    - name: zmk-pmw3610-driver
      remote: inorichi
      # Preserve legacy CONFIG_PMW3610_* and scroll-layers support for ZMK v0.2.
      revision: 1d9c2c68ca76012e1b1e5f6ef02fa5eadc4ca399
    - name: zmk-rgbled-widget
      remote: caksoylar
      revision: v0.3-branch
  self:
    path: config
```
